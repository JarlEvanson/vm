## Kconfig
```kconfig
mainmenu "REVM Configuration"

menu "General Compiler Options"

choice GENERAL_OPTIMIZATION_LEVEL
    prompt "Compiler optimization level"
    default GENERAL_OPTIMIZE_DEBUGGING

config GENERAL_OPTIMIZE_PERFORMANCE
    bool "Optimize for performance"
    help
      Enables standard performance optimizations.

config GENERAL_OPTIMIZE_SIZE
    bool "Optimize for size"
    help
      Enables size optimizations.

config GENERAL_OPTIMIZE_DEBUGGING
    bool "Optimize for debugging"
    help
      Enables optimizations that do not interfere with debugging.

endchoice

config GENERAL_INCREMENTAL
    bool
    default GENERAL_OPTIMIZE_DEBUGGING

config GENERAL_DEBUG_ASSERTIONS
    bool "Enable debug assertions"
    default y

config GENERAL_DEBUG_INFO
    bool "Generate debug info"
    default y

choice GENERAL_LTO
    prompt "Link-Time Optimization (LTO)"
    default GENERAL_LTO_DISABLED

config GENERAL_LTO_DISABLED
    bool "Disable LTO"

config GENERAL_LTO_THIN
    bool "Thin LTO"

config GENERAL_LTO_FAT
    bool "Fat LTO"

endchoice

endmenu

source stub/Kconfig
source revm/Kconfig
```

## revm/Kconfig
```kconfig
menu "REVM"

menu "Compiler Options"

choice REVM_ARCH
    prompt "Target Architecture (revm)"
    default REVM_ARCH_AARCH64

config REVM_ARCH_AARCH64
    bool "aarch64"
    depends on STUB_ARCH_AARCH64

config REVM_ARCH_I686
    bool "i686"
    depends on STUB_ARCH_I686 || STUB_ARCH_X86_64

config REVM_ARCH_X86_64
    bool "x86_64"
    depends on STUB_ARCH_I686 || STUB_ARCH_X86_64

endchoice

config REVM_ARCH_TARGET_TRIPLET
    string
    default "aarch64-unknown-none" if REVM_ARCH_AARCH64
    default "i686-unknown-none" if REVM_ARCH_I686
    default "x86_64-unknown-none" if REVM_ARCH_X86_64

choice REVM_OPTIMIZATION_LEVEL
    prompt "Compiler optimization level"
    default REVM_OPTIMIZE_PERFORMANCE if GENERAL_OPTIMIZE_PERFORMANCE
    default REVM_OPTIMIZE_SIZE if GENERAL_OPTIMIZE_SIZE
    default REVM_OPTIMIZE_DEBUGGING if GENERAL_OPTIMIZE_DEBUGGING

config REVM_OPTIMIZE_PERFORMANCE
    bool "Optimize for performance"
    help
      Enables standard performance optimizations.

config REVM_OPTIMIZE_SIZE
    bool "Optimize for size"
    help
      Enables size optimizations.

config REVM_OPTIMIZE_DEBUGGING
    bool "Optimize for debugging"
    help
      Enables optimizations that do not interfere with debugging.

endchoice

config REVM_INCREMENTAL
    bool
    default REVM_OPTIMIZE_DEBUGGING

config REVM_DEBUG_ASSERTIONS
    bool "Enable debug assertions"
    default GENERAL_DEBUG_ASSERTIONS

config REVM_DEBUG_INFO
    bool "Generate debug info"
    default GENERAL_DEBUG_INFO

choice REVM_LTO
    prompt "Link-Time Optimization (LTO)"
    default REVM_LTO_DISABLED if GENERAL_LTO_DISABLED
    default REVM_LTO_THIN if GENERAL_LTO_THIN
    default REVM_LTO_FAT if GENERAL_LTO_FAT

config REVM_LTO_DISABLED
    bool "Disable LTO"

config REVM_LTO_THIN
    bool "Thin LTO"

config REVM_LTO_FAT
    bool "Fat LTO"

endchoice

endmenu

source revm/src/drivers/Kconfig

endmenu
```

## stub/Kconfig
```kconfig
menu "Revm Stub"

menu "Compiler Options"

choice STUB_ARCH
    prompt "Target Architecture (revm-stub)"
    default STUB_ARCH_AARCH64

config STUB_ARCH_AARCH64
    bool "aarch64"
    select STUB_PLATFORM_SUPPORTS_LIMINE

config STUB_ARCH_I686
    bool "i686"

config STUB_ARCH_X86_64
    bool "x86_64"
    select STUB_PLATFORM_SUPPORTS_LIMINE

endchoice

config STUB_ARCH_TARGET_TRIPLET
    string
    default "aarch64-unknown-none" if STUB_ARCH_AARCH64
    default "i686-unknown-none" if STUB_ARCH_I686
    default "x86_64-unknown-none" if STUB_ARCH_X86_64

choice STUB_OPTIMIZATION_LEVEL
    prompt "Compiler optimization level"
    default STUB_OPTIMIZE_PERFORMANCE if GENERAL_OPTIMIZE_PERFORMANCE
    default STUB_OPTIMIZE_SIZE if GENERAL_OPTIMIZE_SIZE
    default STUB_OPTIMIZE_DEBUGGING if GENERAL_OPTIMIZE_DEBUGGING

config STUB_OPTIMIZE_PERFORMANCE
    bool "Optimize for performance"
    help
      Enables standard performance optimizations.

config STUB_OPTIMIZE_SIZE
    bool "Optimize for size"
    help
      Enables size optimizations.

config STUB_OPTIMIZE_DEBUGGING
    bool "Optimize for debugging"
    help
      Enables optimizations that do not interfere with debugging.

endchoice

config STUB_INCREMENTAL
    bool
    default STUB_OPTIMIZE_DEBUGGING

config STUB_DEBUG_ASSERTIONS
    bool "Enable debug assertions"
    default GENERAL_DEBUG_ASSERTIONS

config STUB_DEBUG_INFO
    bool "Generate debug info"
    default GENERAL_DEBUG_INFO

choice STUB_LTO
    prompt "Link-Time Optimization (LTO)"
    default STUB_LTO_DISABLED if GENERAL_LTO_DISABLED
    default STUB_LTO_THIN if GENERAL_LTO_THIN
    default STUB_LTO_FAT if GENERAL_LTO_FAT

config STUB_LTO_DISABLED
    bool "Disable LTO"

config STUB_LTO_THIN
    bool "Thin LTO"

config STUB_LTO_FAT
    bool "Fat LTO"

endchoice

endmenu

config STUB_PLATFORM_SUPPORTS_LIMINE
    bool

source stub/src/platform/Kconfig

endmenu
```

## stub/src/platform/Kconfig
```kconfig
menu "Platforms"

config STUB_PLATFORM_UEFI
    bool "Enable booting from UEFI"

config STUB_PLATFORMS_VALID
    bool
    default y
    depends on STUB_PLATFORM_UEFI

endmenu
```
